## conf/distro/rk-all.conf
```bitbake
require conf/distro/include/rk-base.inc

DISTRO = "rk-all"
DISTRO_NAME = "Rockchip All"

PREFERRED_PROVIDER_virtual/kernel = "linux-rockchip"

# These are wayland specific
DISTRO_FEATURES_append += " x11 wayland pam"

LICENSE_FLAGS_WHITELIST="commercial"
```

## conf/layer.conf
```bitbake
# Copyright (C) 2017 Jacob Chen
# Released under the MIT license (see COPYING.MIT for the terms)

# We have a conf and classes directory, add to BBPATH
BBPATH .= ":${LAYERDIR}"

# We have recipes-* directories, add to BBFILES
BBFILES += "${LAYERDIR}/recipes-*/*/*.bb ${LAYERDIR}/recipes-*/*/*.bbappend"

BBFILE_COLLECTIONS += "rockchip_fun"
BBFILE_PATTERN_rockchip_fun = "^${LAYERDIR}/"
BBFILE_PRIORITY_rockchip_fun = "1"

# This should only be incremented on significant changes that will
# cause compatibility issues with other layers
LAYERVERSION_rockchip_fun = "1"

LAYERDEPENDS_rockchip_fun = "core"
LICENSE_PATH += "${LAYERDIR}/licenses"
```
